## config/west.yml
```yaml
manifest:
  remotes:
    - name: zmkfirmware
      url-base: https://github.com/zmkfirmware
    - name: DoctorWangWang
      url-base: https://github.com/DoctorWangWang
    - name: caksoylar
      url-base: https://github.com/caksoylar

  projects:
    - name: zmk
      remote: zmkfirmware
      revision: v0.3
      import: app/west.yml

    - name: zmk-pmw3610-driver
      remote: DoctorWangWang
      revision: main

    - name: zmk-rgbled-widget
      remote: caksoylar
      revision: main

  self:
    path: config
```
